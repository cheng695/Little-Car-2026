#include "oled.hpp"

#include <string.h>

namespace
{
    // SSD1306 I2C 控制字节：后续 1 字节为命令。
    constexpr uint8_t kControlCommand = 0x00;
    // SSD1306 I2C 控制字节：后续字节为显存数据。
    constexpr uint8_t kControlData = 0x40;
    // OLED I2C 阻塞发送超时时间，单位 ms。
    constexpr uint32_t kI2cTimeout = 100;
    // 当前内置 ASCII 字库宽度。
    constexpr uint8_t kFontWidth = 6;
    // 当前内置 ASCII 字库高度。
    constexpr uint8_t kFontHeight = 8;

    // 6x8 ASCII 字模表，索引范围对应字符 ' ' 到 '~'。
    const uint8_t kFont6x8[][6] =
    {
        {0x00,0x00,0x00,0x00,0x00,0x00},
        {0x00,0x00,0x5F,0x00,0x00,0x00},
        {0x00,0x07,0x00,0x07,0x00,0x00},
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        {0x08,0x04,0x08,0x10,0x08,0x00},
    };
}

namespace BSP::OLED
{
    Oled::Oled(I2C_HandleTypeDef &hi2c, uint8_t address)
        : hi2c_(hi2c), address_(address)
    {
    }

    bool Oled::Init()
    {
        // 上电后等待 OLED 电源和内部电荷泵稳定。
        HAL_Delay(100);

        // SSD1306 128x64 I2C 初始化序列。
        const uint8_t commands[] =
        {
            0xAE, 0x20, 0x10, 0xB0, 0xC8, 0x00, 0x10, 0x40,
            0x81, 0x7F, 0xA1, 0xA6, 0xA8, 0x3F, 0xA4, 0xD3,
            0x00, 0xD5, 0x80, 0xD9, 0xF1, 0xDA, 0x12, 0xDB,
            0x40, 0x8D, 0x14, 0xAF
        };

        for (uint8_t command : commands)
        {
            if (!WriteCommand(command))
            {
                // 任意命令发送失败则认为初始化失败。
                initialized_ = false;
                return false;
            }
        }

        // 初始化成功后清空显存并刷新到屏幕。
        initialized_ = true;
        Fill(Color::Black);
        return Update();
    }

    bool Oled::IsReady(uint32_t timeout) const
    {
        // HAL 需要传入左移后的 8 位设备地址。
        return HAL_I2C_IsDeviceReady(&hi2c_, DeviceAddress(), 3, timeout) == HAL_OK;
    }

    bool Oled::Update()
    {
        if (!initialized_)
        {
            return false;
        }

        // SSD1306 按页刷新，每页高度为 8 像素，共 8 页。
        for (uint8_t page = 0; page < kPages; page++)
        {
            // 设置当前页地址和列地址起点。
            if (!WriteCommand(0xB0 + page) || !WriteCommand(0x00) || !WriteCommand(0x10))
            {
                return false;
            }

            // 每页连续发送 128 字节显存数据。
            if (!WriteData(&buffer_[kWidth * page], kWidth))
            {
                return false;
            }
        }

        return true;
    }

    void Oled::Fill(Color color)
    {
        // Black/White 可以直接填充整个显存。
        uint8_t value = 0x00;
        if (color == Color::White)
        {
            value = 0xFF;
        }

        // Inverse 需要逐字节翻转当前显存内容。
        if (color == Color::Inverse)
        {
            for (uint16_t i = 0; i < sizeof(buffer_); i++)
            {
                buffer_[i] = ~buffer_[i];
            }
            return;
        }

        memset(buffer_, value, sizeof(buffer_));
    }

    bool Oled::Clear()
    {
        // 清屏同时将光标复位到左上角。
        Fill(Color::Black);
        SetCursor(0, 0);
        return Update();
    }

    void Oled::SetCursor(uint8_t x, uint8_t y)
    {
        cursor_x_ = x;
        cursor_y_ = y;
    }

    void Oled::DrawPixel(uint8_t x, uint8_t y, Color color)
    {
        // 超出屏幕范围的像素直接忽略。
        if (x >= kWidth || y >= kHeight)
        {
            return;
        }

        // 每个字节表示同一列中连续 8 个纵向像素。
        const uint16_t index = x + (y / 8) * kWidth;
        const uint8_t mask = 1u << (y % 8);

        switch (color)
        {
            case Color::White:
                buffer_[index] |= mask;
                break;
            case Color::Black:
                buffer_[index] &= static_cast<uint8_t>(~mask);
                break;
            case Color::Inverse:
                buffer_[index] ^= mask;
                break;
        }
    }

    bool Oled::WriteChar(char ch, Color color)
    {
        // 字库只包含可打印 ASCII 字符，不支持的字符用 '?' 代替。
        if (ch < ' ' || ch > '~')
        {
            ch = '?';
        }

        // 当前行空间不足时自动换到下一行。
        if (cursor_x_ + kFontWidth > kWidth)
        {
            cursor_x_ = 0;
            cursor_y_ += kFontHeight;
        }

        // 超出屏幕底部则写入失败。
        if (cursor_y_ + kFontHeight > kHeight)
        {
            return false;
        }

        // 字模按列存储，逐列逐位写入显存。
        const uint8_t *glyph = kFont6x8[ch - ' '];

        for (uint8_t col = 0; col < kFontWidth; col++)
        {
            uint8_t line = glyph[col];
            for (uint8_t row = 0; row < kFontHeight; row++)
            {
                const bool pixel_on = (line & 0x01u) != 0;
                DrawPixel(cursor_x_ + col, cursor_y_ + row, pixel_on ? color : Color::Black);
                line >>= 1;
            }
        }

        cursor_x_ += kFontWidth;
        return true;
    }

    bool Oled::WriteString(const char *str, Color color)
    {
        // 空指针保护。
        if (str == nullptr)
        {
            return false;
        }

        while (*str != '\0')
        {
            // 支持 '\n' 手动换行。
            if (*str == '\n')
            {
                cursor_x_ = 0;
                cursor_y_ += kFontHeight;
                str++;
                continue;
            }

            if (!WriteChar(*str, color))
            {
                return false;
            }
            str++;
        }

        return true;
    }

    bool Oled::WriteInt(int32_t value, Color color)
    {
        // int32_t 最长为 -2147483648，共 11 个字符，再加结束符。
        char text[12] = {};
        uint8_t index = 0;
        bool negative = false;
        uint32_t number = 0;

        // 避免直接对 INT32_MIN 取负导致溢出。
        if (value < 0)
        {
            negative = true;
            number = static_cast<uint32_t>(-(value + 1)) + 1u;
        }
        else
        {
            number = static_cast<uint32_t>(value);
        }

        do
        {
            // 先按低位到高位写入临时缓冲。
            text[index++] = static_cast<char>('0' + number % 10u);
            number /= 10u;
        } while (number != 0u && index < sizeof(text) - 1u);

        if (negative && index < sizeof(text) - 1u)
        {
            text[index++] = '-';
        }

        for (uint8_t i = 0; i < index / 2u; i++)
        {
            // 翻转字符串，得到正常高位到低位顺序。
            const char temp = text[i];
            text[i] = text[index - 1u - i];
            text[index - 1u - i] = temp;
        }

        return WriteString(text, color);
    }

    bool Oled::WriteCommand(uint8_t command)
    {
        // 命令包格式：控制字节 0x00 + 1 字节命令。
        uint8_t data[2] = {kControlCommand, command};
        return HAL_I2C_Master_Transmit(&hi2c_, DeviceAddress(), data, sizeof(data), kI2cTimeout) == HAL_OK;
    }

    bool Oled::WriteData(const uint8_t *data, uint16_t size)
    {
        // 数据包格式：控制字节 0x40 + 最多一整页 128 字节数据。
        uint8_t packet[kWidth + 1] = {kControlData};
        if (size > kWidth)
        {
            return false;
        }

        memcpy(&packet[1], data, size);
        return HAL_I2C_Master_Transmit(&hi2c_, DeviceAddress(), packet, size + 1u, kI2cTimeout) == HAL_OK;
    }

    uint16_t Oled::DeviceAddress() const
    {
        // STM32 HAL I2C 发送函数要求 7 位地址左移 1 位。
        return static_cast<uint16_t>(address_) << 1;
    }
}
